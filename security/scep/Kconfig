## security/scep/Kconfig
```kconfig
# SPDX-License-Identifier: GPL-2.0-only
config SECURITY_SCEP
	bool "SCEP support"
	depends on SECURITY
	select CRYPTO
	select CRYPTO_LIB_BLAKE2S
	select CRYPTO_BLAKE2S_X86 if X86 && 64BIT
	select ARM_CRYPTO if ARM
	select ARM64_CRYPTO if ARM64
	select CRYPTO_BLAKE2S_ARM if ARM
	default n
	help
	  If you are unsure how to answer this question, answer N.
```
